## main/Kconfig.projbuild
```kconfig
menu "Voice Assistant"

    config VA_TIMEZONE
        string "POSIX timezone string"
        default "CET-1CEST,M3.5.0,M10.5.0/3"
        help
            Used so the assistant can resolve "next Tuesday at 3".

    config VA_TOKEN_URL
        string "Ephemeral token endpoint (optional)"
        default ""
        help
            URL that returns a short-lived Gemini Live token.
            Leave empty to use VA_GEMINI_API_KEY (prototyping only).

    config VA_GEMINI_API_KEY
        string "Gemini API key (prototyping only, do not ship)"
        default ""

    config VA_GEMINI_MODEL
        string "Gemini Live model"
        default "models/gemini-live-latest"
        help
            Check the Gemini docs for the current native-audio Live model name.

    config VA_VOICE_NAME
        string "Voice name"
        default "Puck"

    config VA_WAKENET_KEYWORD
        string "Wake word model keyword"
        default "jarvis"
        help
            Substring used to pick the WakeNet model, e.g. "jarvis" for
            wn9_jarvis_tts. The model itself must be enabled under
            ESP Speech Recognition in menuconfig.

    config VA_AFE_INPUT_FORMAT
        string "AFE input channel layout"
        default "MMNR"
        help
            One letter per I2S channel from the ES7210: M = microphone,
            R = playback reference (for echo cancellation), N = unused.
            TODO: verify against the board schematic.

    config VA_IDLE_TIMEOUT_S
        int "End session after N seconds of silence"
        default 20
        help
            Closes the Gemini session (and turns Wi-Fi off on battery)
            to save power and tokens.

    config VA_WIFI_OFF_WHEN_IDLE
        bool "Turn Wi-Fi off between conversations"
        default y
        help
            Big battery saving. Adds roughly 1-3 s reconnect latency
            after the wake word; speech is buffered meanwhile.

endmenu
```
